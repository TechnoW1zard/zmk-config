## boards/shields/lily58_custom/Kconfig.shield
```kconfig
# Copyright (c) 2020 Pete Johanson
# SPDX-License-Identifier: MIT

config SHIELD_LILY58_CUSTOM_LEFT
    def_bool $(shields_list_contains,lily58_custom_left)

config SHIELD_LILY58_CUSTOM_RIGHT
    def_bool $(shields_list_contains,lily58_custom_right)
```
