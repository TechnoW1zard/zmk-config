/* OLED секция */
&i2c1 {
    status = "okay";
    sda-pin = <26>;    // ← заменить на ваш SDA pin для OLED!
    scl-pin = <27>;    // ← заменить на ваш SCL pin для OLED!

    oled@3c {
        compatible = "solomon,ssd1306fb";
        reg = <0x3c>;
        width = <128>;
        height = <32>;
        display-rotation = "180";       // 180 если дисплей “вверх ногами”, иначе 0
        label = "OLED_DISPLAY";
    };
};

/* RGB подсветка */
