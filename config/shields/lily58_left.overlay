/* OLED секция */
&i2c1 {
    status = "okay";
    sda-pin = <26>;    // ← заменить на ваш SDA pin для OLED!
    scl-pin = <27>;    // ← заменить на ваш SCL pin для OLED!

    oled@3c {
        compatible = "solomon,ssd1306fb";
        reg = <0x3c>;
        width = <128>;
        height = <32>;
        display-rotation = "180";       // 180 если дисплей “вверх ногами”, иначе 0
        label = "OLED_DISPLAY";
    };
};

/* RGB подсветка */
&ws2812 {
    compatible = "worldsemi,ws2812-spi";
    label = "WS2812";
    spi-max-frequency = <8000000>;
    data-gpios = <&gpio0 30 0>;         // ← заменить на ваш пин Din RGB светодиодов!
    chain-length = <35>;                // ← количество светиков на одной половине
    status = "okay";
};